## Kconfig.ambuild
```kconfig
##
## Copyright (c) 2026 Ambarella International LP
##
## License Identifier: AMBARELLA-2-Clause
##

config CONFIG_BOOT_FREERTOS
	bool "Boot FreeRTOS"
	depends on ($(AMBA_SOC) = "cv72") || ($(AMBA_SOC) = "cv3ad685") || \
		($(AMBA_SOC) = "cv75") || ($(AMBA_SOC) = "n1_655")
	default n

### M3
menu "Cortex-M3"
visible if CONFIG_BOOT_FREERTOS

config CONFIG_BOOT_CM3
	bool "Boot Cortex-M3"
	depends on ($(AMBA_SOC) = "cv72") || ($(AMBA_SOC) = "cv3ad685") || \
		($(AMBA_SOC) = "cv75") || ($(AMBA_SOC) = "n1_655")
	default n

menu "Features"
visible if CONFIG_BOOT_CM3

config CONFIG_CM3_LOG_CONSOLE
	bool "Enable Log Console"
	default n

config CONFIG_CM3_CMVI_LOG_CONSOLE
	bool "Enable CMVI Log Console"
	depends on CONFIG_CM3_LOG_CONSOLE && ($(AMBA_SOC) = "cv75")

config CONFIG_CM3_UART_LOG_CONSOLE
	int "UART Log Console Number"
	depends on CONFIG_CM3_LOG_CONSOLE && !CONFIG_CM3_CMVI_LOG_CONSOLE
	default 1

config CONFIG_CM3_SPI
	bool "Enable SPI Driver"
	default n

choice
	prompt "Data Transfer Mode"
	depends on CONFIG_CM3_SPI
	default CONFIG_CM3_SPI_POLLING_MODE

config CONFIG_CM3_SPI_POLLING_MODE
	bool "Polling"

config CONFIG_CM3_SPI_INTERRUPT_MODE
	bool "Interrupt"
endchoice

menuconfig CONFIG_CM3_RPMSG
	bool "Enable RPMsg Driver"
	default n

config CONFIG_CM3_REMAP_ADDRESS
	hex "Shared Memory Address"
	default 0x0
	depends on CONFIG_CM3_RPMSG

config CONFIG_CM3_REMAP_SIZE
	hex "Shared Memory Size"
	default 0x0
	depends on CONFIG_CM3_RPMSG
endmenu  # Features
endmenu  # Cortex-M3

menu "Cortex-R52"
visible if CONFIG_BOOT_FREERTOS && \
	(($(AMBA_SOC) = "n1_655") || ($(AMBA_SOC) = "cv3ad685"))

config CONFIG_BOOT_R52
	bool "Boot Cortex-R52"
	default n

menu "Features"
visible if CONFIG_BOOT_R52

config CONFIG_R52_LOG_CONSOLE
	bool "Enable Log Console"
	default n

config CONFIG_R52_UART_LOG_CONSOLE
	int "UART Log Console Number"
	default 0
	depends on CONFIG_R52_LOG_CONSOLE

menuconfig CONFIG_R52_RPMSG
	bool "Enable RPMsg Driver"
	default n

config CONFIG_R52_REMAP_ADDRESS
	hex "Shared Memory Address"
	default 0x0
	depends on CONFIG_R52_RPMSG

config CONFIG_R52_REMAP_SIZE
	hex "Shared Memory Size"
	default 0x0
	depends on CONFIG_R52_RPMSG

config CONFIG_VIRTIO_SHMEM_START
	hex "Physical memory start reserved for VIRTIO(size is 2MiB)"
	default 0x02000000

endmenu  # Features
endmenu  # Cortex-R52
```
